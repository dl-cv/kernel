/********************************************************************
 * SPDX-License-Identifier: (GPL-2.0+ OR MIT)
 *********************************************************************/

/dts-v1/;

/* Default production board: Sony IMX296, 1 lane, inverted trigger. */
#include "dlcvcam-rk3576-board.dtsi"
#include "dlcvcam-rk3576-csi0.dtsi"
