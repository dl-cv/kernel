## Documentation/devicetree/bindings/hwmon/pwm-fan.txt
```
Bindings for a fan connected to the PWM lines

Required properties:
- compatible	: "pwm-fan"
- pwms		: the PWM that is used to control the PWM fan
- cooling-levels      : PWM duty cycle values in a range from 0 to 255
			which correspond to thermal cooling states

Optional properties:
- fan-supply		: phandle to the regulator that provides power to the fan
- interrupts		: This contains a single interrupt specifier which
			  describes the tachometer output of the fan as an
			  interrupt source. The output signal must generate a
			  defined number of interrupts per fan revolution, which
			  require that it must be self resetting edge interrupts.
			  See interrupt-controller/interrupts.txt for the format.
- pulses-per-revolution : define the tachometer pulses per fan revolution as
			  an integer (default is 2 interrupts per revolution).
			  The value must be greater than zero.
- rockchip,temp-trips	: The property is an array of 2-tuples items, and
			  each item consists of temperature in millicelsius and
			  pwm cooling state. This depends on CONFIG_ROCKCHIP_SYSTEM_MONITOR.
			  If add the property the fan cooling state will be changed
			  by system monitor. Otherwise, use the default thermal governor.
- rockchip,cooling-levels-silent/normal/turbo :
			  Optional per-mode cooling levels. Each property uses
			  the same value format as cooling-levels.
- rockchip,temp-trips-silent/normal/turbo :
			  Optional per-mode temperature to cooling-state mapping.
			  Each property uses the same format as rockchip,temp-trips.
			  If all per-mode properties are present, userspace can
			  switch runtime fan profile among silent/normal/turbo.
			  If they are absent or incomplete, the driver falls back
			  to cooling-levels + rockchip,temp-trips.

Example:
	fan0: pwm-fan {
		compatible = "pwm-fan";
		#cooling-cells = <2>;
		pwms = <&pwm 0 10000 0>;
		cooling-levels = <0 102 170 230>;
	};

	thermal-zones {
		cpu_thermal: cpu-thermal {
			     thermal-sensors = <&tmu 0>;
			     polling-delay-passive = <0>;
			     polling-delay = <0>;
			     trips {
					cpu_alert1: cpu-alert1 {
						    temperature = <100000>; /* millicelsius */
						    hysteresis = <2000>; /* millicelsius */
						    type = "passive";
					};
			     };
			     cooling-maps {
					map0 {
						    trip = <&cpu_alert1>;
						    cooling-device = <&fan0 0 1>;
					};
			     };
		};

Example 2:
	fan0: pwm-fan {
		compatible = "pwm-fan";
		pwms = <&pwm 0 40000 0>;
		fan-supply = <&reg_fan>;
		interrupt-parent = <&gpio5>;
		interrupts = <1 IRQ_TYPE_EDGE_FALLING>;
		pulses-per-revolution = <2>;
	};

Example 3 (Rockchip mode profiles):
	fan0: pwm-fan {
		compatible = "pwm-fan";
		#cooling-cells = <2>;
		pwms = <&pwm 0 50000 0>;

		rockchip,cooling-levels-silent = <0 40 80 140 200>;
		rockchip,temp-trips-silent = <
			50000 1
			55000 2
			60000 3
			65000 4
		>;
		rockchip,cooling-levels-normal = <0 50 100 200 255>;
		rockchip,temp-trips-normal = <
			40000 1
			45000 2
			50000 3
			55000 4
		>;
		rockchip,cooling-levels-turbo = <0 90 150 220 255>;
		rockchip,temp-trips-turbo = <
			35000 1
			40000 2
			45000 3
			50000 4
		>;

		/* Backward compatibility */
		cooling-levels = <0 50 100 200 255>;
		rockchip,temp-trips = <
			40000 1
			45000 2
			50000 3
			55000 4
		>;
	};
```

## Documentation/devicetree/bindings/media/i2c/onnn,ar0521.yaml
```yaml
# SPDX-License-Identifier: (GPL-2.0-only OR BSD-2-Clause)
%YAML 1.2
---
$id: http://devicetree.org/schemas/media/i2c/onnn,ar0521.yaml#
$schema: http://devicetree.org/meta-schemas/core.yaml#

title: ON Semiconductor AR0521 MIPI CSI-2 sensor

maintainers:
  - Krzysztof Hałasa <khalasa@piap.pl>

description: |-
  The AR0521 is a raw CMOS image sensor with MIPI CSI-2 and
  I2C-compatible control interface.

  Some modules provide their own supplies and a local crystal. In that
  case vaa-supply, vdd-supply, vdd_io-supply and clocks are optional.
  When clocks is omitted the driver uses a 27 MHz default for PLL math
  (AND9573 Table 5 RAW10 Full). Do not put clock-frequency on the
  sensor node; describe a fixed-clock and reference it from clocks if
  the rate must be explicit.

properties:
  compatible:
    const: onnn,ar0521

  reg:
    maxItems: 1

  clocks:
    maxItems: 1
    description:
      External input clock (extclk). Optional on modules with an
      on-board crystal; enable is then a no-op.

  clock-names:
    const: extclk

  vaa-supply:
    description:
      Analog (2.7 V) voltage supply. Optional when the module is
      self-powered.

  vdd-supply:
    description:
      Digital core (1.2 V) voltage supply. Optional when the module is
      self-powered.

  vdd_io-supply:
    description:
      Digital I/O (1.8 V) voltage supply. Optional when the module is
      self-powered.

  reset-gpios:
    description: reset GPIO, usually active low
    maxItems: 1

  power-domains:
    maxItems: 1

  pinctrl-names:
    minItems: 1
    maxItems: 2

  pinctrl-0: true
  pinctrl-1: true

  pwms:
    maxItems: 1
    description:
      Single-shot PWM connected to the sensor TRIGGER / GPIO0 pin.

  pwm-names:
    const: trigger

  rockchip,camera-module-index:
    $ref: /schemas/types.yaml#/definitions/uint32
    description: Rockchip camera module index used by RKMODULE_GET_MODULE_INFO.

  rockchip,camera-module-facing:
    $ref: /schemas/types.yaml#/definitions/string
    enum:
      - back
      - front

  rockchip,camera-module-name:
    $ref: /schemas/types.yaml#/definitions/string

  rockchip,camera-module-lens-name:
    $ref: /schemas/types.yaml#/definitions/string

  trigger-mode:
    $ref: /schemas/types.yaml#/definitions/uint32
    enum: [0, 1]
    description: |
      Default operating mode:
        0 = FREE_RUN
        1 = TRIGGER_ONE_SHOT (AND9573 slave / GRR)

  rockchip,trigger-pulse-us:
    $ref: /schemas/types.yaml#/definitions/uint32
    description:
      Software-trigger PWM high pulse width in microseconds. Idle is
      low; the sensor starts a frame on the rising edge.

  light-source-gpios:
    maxItems: 1
    description: Host GPIO that drives the illumination source.

  light-source-active-level:
    $ref: /schemas/types.yaml#/definitions/string
    enum:
      - low
      - high

  light-source-exposure-advance-us:
    $ref: /schemas/types.yaml#/definitions/uint32
    description:
      Microseconds to turn the light source on before the trigger pulse.

  light-source-exposure-off-delay-us:
    $ref: /schemas/types.yaml#/definitions/uint32
    description:
      Microseconds to keep the light source on after the trigger pulse.

  port:
    $ref: /schemas/graph.yaml#/$defs/port-base
    unevaluatedProperties: false
    description: |
      Video output port.

    properties:
      endpoint:
        $ref: /schemas/media/video-interfaces.yaml#
        unevaluatedProperties: false

        properties:
          bus-type:
            const: 4
          data-lanes:
            anyOf:
              - items:
                  - const: 1
              - items:
                  - const: 1
                  - const: 2
              - items:
                  - const: 1
                  - const: 2
                  - const: 3
                  - const: 4

required:
  - compatible
  - reg
  - port

additionalProperties: false

examples:
  - |
    #include <dt-bindings/gpio/gpio.h>

    ar0521_extclk: ar0521-extclk {
            compatible = "fixed-clock";
            #clock-cells = <0>;
            clock-frequency = <27000000>;
            clock-output-names = "ar0521_extclk";
    };

    i2c {
            #address-cells = <1>;
            #size-cells = <0>;

            ar0521: camera-sensor@36 {
                    compatible = "onnn,ar0521";
                    reg = <0x36>;
                    pinctrl-names = "default";
                    pinctrl-0 = <&pinctrl_mipi_camera>;
                    clocks = <&ar0521_extclk>;
                    clock-names = "extclk";
                    reset-gpios = <&gpio1 7 GPIO_ACTIVE_LOW>;

                    port {
                           mipi_camera_to_mipi_csi2: endpoint {
                                    remote-endpoint = <&mipi_csi2_in>;
                                    data-lanes = <1 2 3 4>;
                            };
                    };
            };
    };
```

## Documentation/devicetree/bindings/media/i2c/sony,imx334.yaml
```yaml
# SPDX-License-Identifier: (GPL-2.0-only OR BSD-2-Clause)
%YAML 1.2
---
$id: http://devicetree.org/schemas/media/i2c/sony,imx334.yaml#
$schema: http://devicetree.org/meta-schemas/core.yaml#

title: Sony IMX334 Sensor

maintainers:
  - Paul J. Murphy <paul.j.murphy@intel.com>
  - Daniele Alessandrelli <daniele.alessandrelli@intel.com>

description:
  Sony IMX334 CMOS image sensor connected through a four-lane MIPI CSI-2
  interface. The input clock may be supplied by the host or by an oscillator
  on the camera module. In slave operation XVS and XHS are supplied by two PWM
  outputs.

properties:
  compatible:
    const: sony,imx334

  reg:
    maxItems: 1

  clocks:
    maxItems: 1

  clock-names:
    items:
      - enum: [inck, xvclk]

  assigned-clocks: true
  assigned-clock-parents: true
  assigned-clock-rates: true

  power-domains:
    maxItems: 1

  avdd-supply: true
  dvdd-supply: true
  dovdd-supply: true
  ovdd-supply: true

  reset-gpios:
    description: GPIO connected to the active-low XCLR input.
    maxItems: 1

  pwdn-gpios:
    maxItems: 1

  pwms:
    minItems: 2
    maxItems: 2

  pwm-names:
    items:
      - const: xvs
      - const: xhs

  trigger-mode:
    description: Default mode, 0 for continuous synchronization and 1 for one-shot XVS.
    enum: [0, 1]
    default: 0

  rockchip,xvs-pulse-us:
    $ref: /schemas/types.yaml#/definitions/uint32
    minimum: 1
    maximum: 1000

  rockchip,xvs-period-ns:
    $ref: /schemas/types.yaml#/definitions/uint32

  rockchip,xhs-period-ns:
    $ref: /schemas/types.yaml#/definitions/uint32

  rockchip,xhs-duty-ns:
    $ref: /schemas/types.yaml#/definitions/uint32

  light-source-gpios:
    maxItems: 1

  light-source-active-level:
    enum: [low, high]

  light-source-exposure-advance-us:
    $ref: /schemas/types.yaml#/definitions/uint32
    maximum: 100000

  light-source-exposure-off-delay-us:
    $ref: /schemas/types.yaml#/definitions/uint32
    maximum: 1000000

  rockchip,camera-module-index:
    $ref: /schemas/types.yaml#/definitions/uint32

  rockchip,camera-module-facing:
    enum: [back, front]

  rockchip,camera-module-name:
    $ref: /schemas/types.yaml#/definitions/string

  rockchip,camera-module-lens-name:
    $ref: /schemas/types.yaml#/definitions/string

  port:
    additionalProperties: false
    $ref: /schemas/graph.yaml#/$defs/port-base
    properties:
      endpoint:
        $ref: /schemas/media/video-interfaces.yaml#
        unevaluatedProperties: false
        properties:
          data-lanes:
            minItems: 4
            maxItems: 4
          link-frequencies:
            minItems: 1
            maxItems: 1
        required:
          - data-lanes
          - link-frequencies
    required:
      - endpoint

required:
  - compatible
  - reg
  - avdd-supply
  - dvdd-supply
  - port

additionalProperties: false

examples:
  - |
    #include <dt-bindings/gpio/gpio.h>
    #include <dt-bindings/pwm/pwm.h>

    i2c {
        #address-cells = <1>;
        #size-cells = <0>;

        camera@1a {
            compatible = "sony,imx334";
            reg = <0x1a>;
            avdd-supply = <&camera_avdd>;
            dvdd-supply = <&camera_dvdd>;
            reset-gpios = <&gpio3 28 GPIO_ACTIVE_LOW>;
            pwm-names = "xvs", "xhs";
            pwms = <&pwm1 1 33333333 PWM_POLARITY_NORMAL>,
                   <&pwm0 1 14815 PWM_POLARITY_NORMAL>;
            trigger-mode = <1>;
            rockchip,xvs-pulse-us = <15>;
            rockchip,xvs-period-ns = <33333333>;
            rockchip,xhs-period-ns = <14815>;
            rockchip,xhs-duty-ns = <200>;

            port {
                imx334: endpoint {
                    remote-endpoint = <&cam>;
                    data-lanes = <1 2 3 4>;
                    link-frequencies = /bits/ 64 <445500000>;
                };
            };
        };
    };
...
```
